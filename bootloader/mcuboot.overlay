/* SPDX-License-Identifier: Apache-2.0 */
/* USB CDC ACM port MCUboot serial recovery uses. */

&zephyr_udc0 {
	cdc_acm_uart0: cdc_acm_uart0 {
		compatible = "zephyr,cdc-acm-uart";
	};
};

/ {
	chosen {
		zephyr,uart-mcumgr = &cdc_acm_uart0;
	};
};

