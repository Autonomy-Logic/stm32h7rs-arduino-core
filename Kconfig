## Kconfig
```kconfig
#
# Copyright (c) 2022 Dhruva Gole
#
# SPDX-License-Identifier: Apache-2.0
#

config ARDUINO_API
	bool "ARDUINO_API"
	imply CPP
	imply GPIO
	imply I2C
	imply NEWLIB_LIBC_FLOAT_PRINTF
	imply CBPRINTF_FP_SUPPORT
	imply PINCTRL_KEEP_SLEEP_STATE
	select UART_INTERRUPT_DRIVEN
	default n

if ARDUINO_API

config QEMU_ICOUNT
	bool "QEMU icount mode"
	default n
	depends on QEMU_TARGET

config ARDUINO_API_SERIAL_BUFFER_SIZE
	int "Buffer size for Arduino Serial API"
	default 1024

config ARDUINO_ETHERNET_KEEP_DRIVER_MAC
	bool "Ethernet.begin() keeps the MAC address set by the Ethernet driver"
	default n
	help
	  Ethernet.begin() ignores the MAC address passed by the sketch, so the interface keeps the
	  address its driver chose at init (on STM32, derived from the chip's unique ID).

config ARDUINO_STM32_DISPLAY_HAL
	bool "Build ST's LTDC and DMA2D HAL into the loader for sketches"
	depends on SOC_FAMILY_STM32
	select USE_STM32_HAL_LTDC
	select USE_STM32_HAL_DMA2D
	help
	  Lets a sketch or board HAL drive the LTDC display controller and the DMA2D engine with
	  ST's HAL, so panel set-up stays outside the core.

config ARDUINO_STM32H7RS_NETBOOT
	bool "Program side of the STM32H7S7 network bootloader"
	depends on SOC_SERIES_STM32H7RSX
	select FLASH
	select CRC
	help
	  Refreshes the watchdog the network bootloader arms, clears its start-up strike count once the
	  program has run for a while, restarts into the bootloader on request and stores the network
	  settings the bootloader uses (docs/network-bootloader.md).

config ARDUINO_ENTRY
	bool "Provide arduino setup and loop entry points"
	default y

config ARDUINO_MAX_TONES
	int "Maximum number of tones that can be played simultaneously with tone()"
	default -1
	help
	  Specify the maximum number of tones that can be played simultaneously with tone().
	  If set to -1 (or any other negative value), the maximum number will be
	  determined from the system's digital pin configuration.

endif

if USB_DEVICE_STACK_NEXT

config USB_DEVICE_PRODUCT
	string "USB Device Product"
	default "Arduino Generic board"

config USB_DEVICE_MANUFACTURER
	string "USB Device Manufacturer"
	default "Arduino"

config USB_DEVICE_VID
	hex "USB Device Vendor ID"
	default 0x2341

config USB_DEVICE_PID
	hex "USB Device Product ID"
	default 0x0001

endif
```

## boards/autonomylogic/stm32h7s7_core/Kconfig.defconfig
```kconfig
# SPDX-License-Identifier: Apache-2.0

if BOARD_STM32H7S7_CORE

configdefault ETH_DRIVER
	default y

endif # BOARD_STM32H7S7_CORE
```

## boards/autonomylogic/stm32h7s7_core/Kconfig.stm32h7s7_core
```kconfig
# SPDX-License-Identifier: Apache-2.0

config BOARD_STM32H7S7_CORE
	select SOC_STM32H7S7XX
```

## boards/autonomylogic/stm32h7s7_core/Kconfig.sysbuild
```kconfig
# SPDX-License-Identifier: Apache-2.0

if BOARD_STM32H7S7_CORE_STM32H7S7XX_EXT_FLASH_APP

choice BOOTLOADER
	default BOOTLOADER_MCUBOOT
endchoice

choice BOOT_SIGNATURE_TYPE
	default BOOT_SIGNATURE_TYPE_ECDSA_P256
endchoice

choice MCUBOOT_MODE
	default MCUBOOT_MODE_SINGLE_APP
endchoice

endif # BOARD_STM32H7S7_CORE_STM32H7S7XX_EXT_FLASH_APP
```

## boards/autonomylogic/stm32h7s7_core/board.yml
```yaml
board:
  name: stm32h7s7_core
  full_name: STM32H7S7 core (external flash XIP)
  vendor: autonomylogic
  socs:
    - name: stm32h7s7xx
      variants:
        - name: ext_flash_app
        - name: sl_visu_5r
```
